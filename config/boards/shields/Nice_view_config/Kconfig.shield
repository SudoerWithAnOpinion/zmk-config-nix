## config/boards/shields/Nice_view_config/Kconfig.shield
```kconfig
config SHIELD_NICE_VIEW_CONFIG
    def_bool $(shields_list_contains,Nice_view_config)
```

## config/boards/shields/Sofle_dongle/Kconfig.shield
```kconfig
# Copyright (c) 2020 The ZMK Contributors
# SPDX-License-Identifier: MIT

config SHIELD_SOFLE_DONGLE_CENTRAL
    def_bool $(shields_list_contains,Sofle_dongle_central)

config SHIELD_SOFLE_DONGLE_LEFT
    def_bool $(shields_list_contains,Sofle_dongle_left)

config SHIELD_SOFLE_DONGLE_RIGHT
    def_bool $(shields_list_contains,Sofle_dongle_right)
```

## config/boards/shields/eyeslash_dongle_config/Kconfig.shield
```kconfig
config SHIELD_EYESLASH_DONGLE_CONFIG
    def_bool $(shields_list_contains,eyeslash_dongle_config)
```
