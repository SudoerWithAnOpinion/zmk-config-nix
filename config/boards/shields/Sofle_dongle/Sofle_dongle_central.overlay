/*
*
* Copyright (c) 2021 Darryl deHaan
* SPDX-License-Identifier: MIT
*
*/

#include "Sofle_dongle.dtsi"

/{
    chosen {
        zmk,kscan = &mock_kscan;
        zephyr,display = &oled;
    };
    mock_kscan: kscan_1 {
        compatible = "zmk,kscan-mock";
        columns = <0>;
        rows = <0>;
        events = <0>;
    };
};
