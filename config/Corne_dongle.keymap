/*
 * Copyright (c) 2020 The ZMK Contributors
 *
 * SPDX-License-Identifier: MIT
 */

#include <behaviors.dtsi>
#include <dt-bindings/zmk/keys.h>
#include <dt-bindings/zmk/bt.h>
#include <dt-bindings/zmk/outputs.h>
#include "zmk-helpers/helper.h"
#include <behaviors/unicode.dtsi>
#include <zmk-unicode/keys/blocks/letterlike_symbols.h>

#define BASE       0
#define LOWER      1
#define RAISE      2
#define ADJUST     3
#define ACCENT_SEL 4
#define ACUTE      5
#define GRAVES      6
#define CIRCUMFLEX 7
#define DIAERESIS  8
#define SPECIAL    9
#define OGONEK     10
#define DOT_MARKS  11
#define COMMA_BELOW 12
#define DBL_ACUTE  13
#define CARON_BREVE 14
#define RING       15
#define MACRON     16

#define UC_I_OGONEK       0x12f   0x12e   // i/ I ogonek
#define UC_U_OGONEK       0x173   0x172   // u/ U ogonek
#define UC_A_DOT_BELOW    0x1ea1  0x1ea0  // a dot below
#define UC_E_DOT_BELOW    0x1eb9  0x1eb8  // e dot below
#define UC_I_DOT_BELOW    0x1ecb  0x1eca  // i dot below
#define UC_O_DOT_BELOW    0x1ecd  0x1ecc  // o dot below
#define UC_U_DOT_BELOW    0x1ee5  0x1ee4  // u dot below
#define UC_C_DOT_ABOVE    0x10b   0x10a   // c dot above
#define UC_S_DOT_ABOVE    0x1e61  0x1e60  // s dot above
#define UC_O_DOUBLE_ACUTE 0x151   0x150   // o double acute
#define UC_U_DOUBLE_ACUTE 0x171   0x170   // u double acute
#define UC_E_BREVE        0x115   0x114   // e breve
#define UC_G_BREVE        0x11f   0x11e   // g breve
#define UC_E_CARON        0x11b   0x11a   // e caron (ě/Ě)
#define UC_L_CARON        0x13e   0x13d   // l caron (ľ/Ľ)
#define UC_A_RING         0x00e5  0x00c5  // a ring
#define UC_A_MACRON       0x0101  0x0100  // a macron
#define UC_E_MACRON       0x0113  0x0112  // e macron
#define UC_I_MACRON       0x012b  0x012a  // i macron
#define UC_O_MACRON       0x014d  0x014c  // o macron
#define UC_U_MACRON       0x016b  0x016a  // u macron
#define UC_INV_QMARK      0x00bf  0x00bf  // inverted question
#define UC_INV_EXCL       0x00a1  0x00a1  // inverted exclamation
#define UC_L_GUILLEMET    0x00ab  0x00ab  // left guillemet
#define UC_R_GUILLEMET    0x00bb  0x00bb  // right guillemet
#define UC_LOW_DBL_QUOTE  0x201e  0x201e  // low double quote
#define UC_L_DBL_QUOTE    0x201c  0x201c  // left double quote
#define UC_R_DBL_QUOTE    0x201d  0x201d  // right double quote
#define UC_I_GRAVE        0x00ec  0x00cc  // i grave
#define UC_O_GRAVE        0x00f2  0x00d2  // o grave
#define UC_SAME(_cp)      _cp _cp

// ZMK_MOD_MORPH(nav_left_home,
//     bindings = <&kp LEFT>, <&kp HOME>;
//     mods = <(MOD_LSFT|MOD_RSFT)>;
// )

// ZMK_MOD_MORPH(nav_up_pgup,
//     bindings = <&kp UP>, <&kp PG_UP>;
//     mods = <(MOD_LSFT|MOD_RSFT)>;
// )

// ZMK_MOD_MORPH(nav_down_pgdn,
//     bindings = <&kp DOWN>, <&kp PG_DN>;
//     mods = <(MOD_LSFT|MOD_RSFT)>;
// )

// ZMK_MOD_MORPH(nav_right_end,
//     bindings = <&kp RIGHT>, <&kp END>;
//     mods = <(MOD_LSFT|MOD_RSFT)>;
// )

ZMK_MOD_MORPH(bksp_del_mod,
    bindings = <&kp BSPC>, <&kp DEL>;
    mods = <(MOD_LCTL|MOD_RCTL|MOD_LSFT|MOD_RSFT|MOD_LALT|MOD_RALT|MOD_LGUI|MOD_RGUI)>;
)

ZMK_TAP_DANCE(td_lshift_capsw,
    tapping-term-ms = <200>;
    bindings = <&kp LSHFT>, <&caps_word>;
)

ZMK_MOD_MORPH(acute_dblacute_sel,
        bindings = <&asl ACUTE>, <&asl DBL_ACUTE>;
        mods = <(MOD_LSFT|MOD_RSFT)>;
)

#define ZMK_BT_SEL_DISC_SHIFT(_name, _slot) \
ZMK_MOD_MORPH(_name, \
    bindings = <&bt BT_SEL _slot>, <&bt BT_DISC _slot>; \
    mods = <(MOD_LSFT|MOD_RSFT)>; \
)

ZMK_BT_SEL_DISC_SHIFT(bt_sel_disc_0, 0)
ZMK_BT_SEL_DISC_SHIFT(bt_sel_disc_1, 1)
ZMK_BT_SEL_DISC_SHIFT(bt_sel_disc_2, 2)
ZMK_BT_SEL_DISC_SHIFT(bt_sel_disc_3, 3)
ZMK_BT_SEL_DISC_SHIFT(bt_sel_disc_4, 4)

// (╯°□°)╯︵ ┻━┻
ZMK_MACRO(table_flip,
    wait-ms = <30>;
    tap-ms = <10>;
        bindings = <&uc UC_SAME(0x28) &uc UC_SAME(0x256F) &uc UC_SAME(0x00B0) &uc UC_SAME(0x25A1) &uc UC_SAME(0x00B0) &uc UC_SAME(0x29) &uc UC_SAME(0x256F) &uc UC_SAME(0xFE35) &uc UC_SAME(0x20) &uc UC_SAME(0x253B) &uc UC_SAME(0x2501) &uc UC_SAME(0x253B)>;
)

// ┬─┬ノ( º _ ºノ)
ZMK_MACRO(table_put,
    wait-ms = <30>;
    tap-ms = <10>;
        bindings = <&uc UC_SAME(0x252C) &uc UC_SAME(0x2500) &uc UC_SAME(0x252C) &uc UC_SAME(0x30CE) &uc UC_SAME(0x28) &kp SPACE &uc UC_SAME(0x00BA) &kp SPACE &kp UNDER &kp SPACE &uc UC_SAME(0x00BA) &uc UC_SAME(0x30CE) &uc UC_SAME(0x29)>;
)

// ಠ_ಠ
ZMK_MACRO(stare,
    wait-ms = <30>;
    tap-ms = <10>;
        bindings = <&uc UC_SAME(0x0CA0) &kp UNDER &uc UC_SAME(0x0CA0)>;
)

// ( つ ◕_◕ )つ
ZMK_MACRO(hug,
    wait-ms = <30>;
    tap-ms = <20>;
        bindings = <&uc UC_SAME(0x28) &kp SPACE &uc UC_SAME(0x3064) &kp SPACE &uc UC_SAME(0x25D5) &kp UNDER &uc UC_SAME(0x25D5) &kp SPACE &uc UC_SAME(0x29) &uc UC_SAME(0x3064)>;
)

// stare / hug morph (shift = hug)
ZMK_MOD_MORPH(stare_morph,
    bindings = <&stare>, <&hug>;
    mods = <(MOD_LSFT|MOD_RSFT)>;
)

// flip / put morph (shift = put table back)
ZMK_MOD_MORPH(table_flip_morph,
    bindings = <&table_flip>, <&table_put>;
    mods = <(MOD_LSFT|MOD_RSFT)>;
)

/ {
        combos {
            compatible = "zmk,combos";
            // J+K → accent selector layer (right hand)
            combo_accent_sel_jk {
                timeout-ms = <50>;
                key-positions = <19 20>;
                bindings = <&sl ACCENT_SEL>;
                layers = <BASE>;
            };
            // D+F → accent selector layer (left hand)
            combo_accent_sel_df {
                timeout-ms = <50>;
                key-positions = <15 16>;
                bindings = <&sl ACCENT_SEL>;
                layers = <BASE>;
            };
            // LSHIFT + RSIFT → CAPSLOCK
            combo_capslck {
                timeout-ms = <50>;
                key-positions = <0 38>;
                bindings = <&kp CAPS>;
                layers = <BASE>;
            };
        };

        // Activate ADJUST layer by pressing raise and lower
        conditional_layers {
            compatible = "zmk,conditional-layers";
            adjust_layer {
                if-layers = <LOWER RAISE>;
                then-layer = <ADJUST>;
            };
        };
        behaviors {
                        asl: accent_sticky_layer {
                                compatible = "zmk,behavior-sticky-key";
                                #binding-cells = <1>;
                                release-after-ms = <1500>;
                                bindings = <&mo>;
                                display-name = "ACC-SL";
                        };
            uc_mode_win: uc_mode_win {
                compatible = "zmk,behavior-mod-morph";
                #binding-cells = <0>;
                bindings = <&uc UC_SET_WIN_COMPOSE>, <&uc UC_SET_WIN_ALT>;
                mods = <(MOD_LSFT|MOD_RSFT)>;
            };
            uc_mode_mac: uc_mode_mac {
                compatible = "zmk,behavior-mod-morph";
                #binding-cells = <0>;
                bindings = <&uc UC_SET_MACOS>, <&uc UC_SET_EMACS>;
                mods = <(MOD_LSFT|MOD_RSFT)>;
            };
            uc_mode_linux: uc_mode_linux {
                compatible = "zmk,behavior-mod-morph";
                #binding-cells = <0>;
                bindings = <&uc UC_SET_LINUX>, <&uc UC_SET_LINUX_ALT>;
                mods = <(MOD_LSFT|MOD_RSFT)>;
            };
        };
        keymap {
                compatible = "zmk,keymap";

                default_layer {
// -----------------------------------------------------------------------------------------
// ╭───────┬─────┬─────┬─────┬─────┬─────╮              ╭─────┬─────┬─────┬─────┬─────┬────────╮
// │   `   │  Q  │  W  │  E  │  R  │  T  │              │  Y  │  U  │  I  │  O  │  P  │BKSP/DEL│
// ├───────┼─────┼─────┼─────┼─────┼─────┤              ├─────┼─────┼─────┼─────┼─────┼────────┤
// │CRL/TAB│  A  │  S  │  D  │  F  │  G  │              │  H  │  J  │  K  │  L  │  ;  │   '    │
// ├───────┼─────┼─────┼─────┼─────┼─────┤              ├─────┼─────┼─────┼─────┼─────┼────────┤
// │ SHFT  │  Z  │  X  │  C  │  V  │  B  │              │  N  │  M  │  ,  │  .  │  /  │SHFT/RET│
// ╰───────┴─────┴─────┴─────┼─────┼─────┼─────╮  ╭─────┼─────┼─────┼─────┴─────┴─────┴────────╯
//                           │ GUI │ LWR │ SPC │  │ ENT │ RSE │ ALT │
//                           ╰─────┴─────┴─────╯  ╰─────┴─────┴─────╯
//                                                             Right Alt isn't working ಠ_ಠ - Use Left Alt
                        bindings = <
//     ╭─────────────────┬──────┬──────┬──────┬─────────┬─────────╮                    ╭──────────┬─────────┬─────────┬────────┬────────┬─────────────╮
        &kp GRAVE         &kp Q  &kp W  &kp E  &kp R     &kp T                          &kp Y      &kp U     &kp I     &kp O    &kp P    &bksp_del_mod
//     ├─────────────────┼──────┼──────┼──────┼─────────┼─────────┤                    ├──────────┼─────────┼─────────┼────────┼────────┼─────────────┤
        &mt LCTRL TAB     &kp A  &kp S  &kp D  &kp F     &kp G                          &kp H      &kp J     &kp K     &kp L    &kp SEMI &kp SQT
//     ├─────────────────┼──────┼──────┼──────┼─────────┼─────────┤                    ├──────────┼─────────┼─────────┼────────┼────────┼─────────────┤
        &td_lshift_capsw  &kp Z  &kp X  &kp C  &kp V     &kp B                          &kp N      &kp M     &kp COMMA &kp DOT  &kp FSLH &mt RSHFT RET
//     ╰─────────────────┴──────┴──────┴──────┼─────────┼─────────┼──────────╮ ╭───────┼──────────┼─────────┼─────────┼────────┴────────┴─────────────╯
                                               &kp LGUI  &mo LOWER  &kp SPACE   &kp RET &mo RAISE  &kp LALT
//                                            ╰─────────┴──────────┴─────────╯ ╰───────┴──────────┴─────────╯

                        >;
                display-name = "ROOT";
                };
                lower_layer {
// -----------------------------------------------------------------------------------------
// ╭───────┬─────┬─────┬─────┬─────┬─────╮              ╭─────┬─────┬─────┬─────┬─────┬─────╮
// │  ESC  │  1  │  2  │  3  │  4  │  5  │              │  6  │  7  │  8  │  9  │  0  │ DEL │
// ├───────┼─────┼─────┼─────┼─────┼─────┤              ├─────┼─────┼─────┼─────┼─────┼─────┤
// │ CTRL  │  !  │  @  │  #  │  $  │  %  │              │  ^  │  &  │  *  │  (  │  )  │  |  │
// ├───────┼─────┼─────┼─────┼─────┼─────┤              ├─────┼─────┼─────┼─────┼─────┼─────┤
// │ SHFT  │  =  │  -  │  +  │  {  │  }  │              │  [  │  ]  │  ;  │  :  │  \  │     │
// ╰───────┴─────┴─────┴─────┼─────┼─────┼─────╮  ╭─────┼─────┼─────┼─────┴─────┴─────┴─────╯
//                           │ GUI │ /// │ SPC │  │ ENT │ /// │ ALT │
//                           ╰─────┴─────┴─────╯  ╰─────┴─────┴─────╯
                        bindings = <
//     ╭─────────────────┬──────────┬──────────┬──────────┬─────────┬─────────╮                    ╭──────────┬─────────┬─────────┬─────────┬─────────┬─────────────╮
        &kp ESC           &kp N1     &kp N2     &kp N3     &kp N4    &kp N5                         &kp N6     &kp N7    &kp N8    &kp N9    &kp N0    &kp DEL
//     ├─────────────────┼──────────┼──────────┼──────────┼─────────┼─────────┤                    ├──────────┼─────────┼─────────┼─────────┼─────────┼─────────────┤
        &mt LCTRL TAB     &kp EXCL   &kp AT     &kp HASH   &kp DLLR  &kp PRCNT                      &kp CARET  &kp AMPS  &kp ASTRK &kp LPAR  &kp RPAR  &kp PIPE
//     ├─────────────────┼──────────┼──────────┼──────────┼─────────┼─────────┤                    ├──────────┼─────────┼─────────┼─────────┼─────────┼─────────────┤
        &td_lshift_capsw  &kp EQUAL  &kp MINUS  &kp PLUS   &kp LBRC  &kp RBRC                       &kp LBKT   &kp RBKT  &kp SEMI  &kp COLON &kp BSLH  &mt RSHFT RET
//     ╰─────────────────┴──────────┴──────────┴──────────┼─────────┼─────────┼──────────╮ ╭───────┼──────────┼─────────┼─────────┴─────────┴─────────┴─────────────╯
                                                           &kp LGUI  &trans    &kp SPACE    &kp RET &trans     &kp LALT
//                                                        ╰─────────┴─────────┴──────────╯ ╰───────┴──────────┴─────────╯
                        >;
                display-name = "DESCEND";
                };

                raise_layer {
// -----------------------------------------------------------------------------------------
// ╭───────┬─────┬─────┬─────┬─────┬─────╮              ╭─────┬─────┬─────┬─────┬─────┬───────╮
// │  TAB  │ F1  │ F2  │ F3  │ F4  │ F5  │              │ F6  │ F7  │ F8  │ F9  │ F10 │  F11  │
// ├───────┼─────┼─────┼─────┼─────┼─────┤              ├─────┼─────┼─────┼─────┼─────┼───────┤
// │ CTRL  │     │     │     │     │     │              │  ←  │  ↓  │  ↑  │  →  │     │  F12  │
// ├───────┼─────┼─────┼─────┼─────┼─────┤              ├─────┼─────┼─────┼─────┼─────┼───────┤
// │ SHFT  │     │     │     │     │     │              │     │     │     │     │     │ SHIFT │
// ╰───────┴─────┴─────┴─────┼─────┼─────┼─────╮  ╭─────┼─────┼─────┼─────┴─────┴─────┴───────╯
//                           │ GUI │ /// │ SPC │  │ ENT │ /// │ ALT │
//                           ╰─────┴─────┴─────╯  ╰─────┴─────┴─────╯
                        bindings = <
//     ╭─────────────────┬───────┬───────┬───────┬──────────┬───────╮                    ╭───────────────┬───────────────┬───────────────┬───────────────┬───────────────┬──────────────╮
        &kp TAB           &kp F1  &kp F2  &kp F3  &kp F4      &kp F5                      &kp F6          &kp F7          &kp F8          &kp F9          &kp F10         &kp F11
//     ├─────────────────┼───────┼───────┼───────┼──────────┼───────┤                    ├───────────────┼───────────────┼───────────────┼───────────────┼───────────────┼──────────────┤
        &kp LCTRL         &none   &none   &none   &none       &none                       &kp LEFT        &kp DOWN        &kp UP          &kp RIGHT       &none           &kp F12
//     ├─────────────────┼───────┼───────┼───────┼──────────┼───────┤                    ├───────────────┼───────────────┼───────────────┼───────────────┼───────────────┼──────────────┤
        &td_lshift_capsw  &none   &none   &none   &none       &none                       &none           &none           &none           &none           &none           &kp RSHFT
//     ╰─────────────────┴───────┴───────┴───────┼──────────┼───────┼──────────╮ ╭───────┼───────────────┼───────────────┼───────────────┴───────────────┴───────────────┴──────────────╯
                                                  &kp LGUI   &trans  &kp SPACE    &kp RET &trans          &kp LALT
//                                               ╰──────────┴───────┴──────────╯ ╰───────┴───────────────┴───────────────╯
                        >;
                display-name = "ASCEND";
                };

                adjust_layer {
// -----------------------------------------------------------------------------------------
// ╭───────┬─────┬─────┬─────┬─────┬─────╮   ╭──────────┬─────────┬───────┬─────┬─────┬───────╮
// │ BTCLR │ BT1 │ BT2 │ BT3 │ BT4 │ BT5 │   │          │         │       │     │     │INSERT │
// ├───────┼─────┼─────┼─────┼─────┼─────┤   ├──────────┼─────────┼───────┼─────┼─────┼───────┤
// │OUTTOG │     │     │ ಠ_ಠ│     │     │   │ HOME     │ PG_UP   │ PG_DN │ END │     │       │
// ├───────┼─────┼─────┼─────┼─────┼─────┤   ├──────────┼─────────┼───────┼─────┼─────┼───────┤
// │       │     │     │     │     │     │   │ UCM_WIN  │UCM_LINUX│UCM_MAC│     │     │       │
// ╰───────┴─────┴─────┼─────┼─────┼─────┤   ├──────────┼─────────┼───────┼─────┴─────┴───────╯
//                     │     │ /// │     │   │          │ ///     │       │
//                     ╰─────┴─────┴─────╯   ╰──────────┴─────────┴───────╯
                        bindings = <
//     ╭──────────────┬───────────────┬──────────────┬───────────────┬───────────────┬───────────────╮                  ╭──────────────┬──────────────┬──────────────┬──────┬──────┬──────╮
        &bt BT_CLR     &bt_sel_disc_0  &bt_sel_disc_1 &bt_sel_disc_2  &bt_sel_disc_3  &bt_sel_disc_4                     &none          &none          &none          &none  &none  &kp INS
//     ├──────────────┼───────────────┼──────────────┼───────────────┼───────────────┼───────────────┤                  ├──────────────┼──────────────┼──────────────┼──────┼──────┼──────┤
        &out OUT_TOG   &none           &none          &stare_morph    &none           &none                              &kp HOME       &kp PG_DN      &kp PG_UP      &kp END  &none  &none
//     ├──────────────┼───────────────┼──────────────┼───────────────┼───────────────┼───────────────┤                  ├──────────────┼──────────────┼──────────────┼──────┼──────┼──────┤
        &none          &none           &none          &none           &none           &none                              &uc_mode_win   &uc_mode_linux &uc_mode_mac   &none  &none  &none
//     ╰──────────────┴───────────────┴──────────────┴───────────────┼───────────────┼───────────────┼───────╮  ╭───────┼──────────────┼──────────────┼──────────────┴──────┴──────┴──────╯
                                                                      &none           &none           &none      &none   &none          &none
//                                                                   ╰───────────────┴───────────────┴───────╯  ╰───────┴──────────────┴──────╯
                        >;
                        display-name = "SHADOW";
                };

// ─── Accent selector ─────────────────────────────────────────────────────
                // Activated by combo J+K or D+F. Press the accent symbol, then the target letter.
                // Router keys: ` grave, '/" acute/double-acute, ; diaeresis, ^/6 circumflex, x/- macron,
                // , comma-below, . dot marks, / special, Q ogonek, R caron/breve, O ring.
                accent_sel_layer {
                        bindings = <
//     ╭──────────┬────────────┬──────┬──────┬───────────────┬────────────────╮                 ╭──────────────┬──────┬──────┬──────────────┬──────────┬─────────╮
        &asl GRAVES &asl OGONEK &none  &none  &asl CARON_BREVE &asl CIRCUMFLEX                   &none          &none  &none  &asl RING     &none      &none
//     ├──────────┼────────────┼──────┼──────┼───────────────┼────────────────┤                 ├──────────────┼──────┼──────┼──────────────┼──────────┼─────────┤
        &none      &none        &none  &none  &none           &none                              &none          &none  &none  &none          &asl DIAERESIS  &acute_dblacute_sel
//     ├──────────┼────────────┼──────┼──────┼───────────────┼────────────────┤                 ├──────────────┼──────┼──────────────┼──────┼──────┼─────────┤
        &none      &none        &asl MACRON  &none  &none           &none                        &none          &none  &asl COMMA_BELOW  &asl DOT_MARKS  &asl SPECIAL  &none
//     ╰──────────┴────────────┴──────┴──────┼───────────────┼────────────────┼──────╮  ╭───────┼──────────────┼──────┼──────────────┴──────┴──────┴─────────╯
                                              &none           &none            &none      &none  &none          &none
//                                           ╰───────────────┴────────────────┴──────╯  ╰───────┴──────────────┴──────╯
                        >;
                        display-name = "ACC-SEL";
                };

                acute_layer {
// ╭───────┬─────┬─────┬─────┬─────┬─────╮              ╭─────┬─────┬─────┬─────┬─────┬───────╮
// │       │     │     │  é  │     │     │              │     │  ú  │  í  │  ó  │     │       │
// ├───────┼─────┼─────┼─────┼─────┼─────┤              ├─────┼─────┼─────┼─────┼─────┼───────┤
// │       │  á  │     │     │     │     │              │     │     │     │     │     │       │
// ├───────┼─────┼─────┼─────┼─────┼─────┤              ├─────┼─────┼─────┼─────┼─────┼───────┤
// │LSHIFT │     │     │     │     │     │              │  ñ  │     │     │  ¡  │  ¿  │ RSHIFT│
// ╰───────┴─────┴─────┴─────┼─────┼─────┼─────╮  ╭─────┼─────┼─────┼─────┴─────┴─────┴───────╯
//                           │     │     │     │  │     │     │     │
//                           ╰─────┴─────┴─────╯  ╰─────┴─────┴─────╯
                        bindings = <
//     ╭──────────┬──────────────────┬──────┬─────────────────┬──────┬──────╮                 ╭──────────────────┬───────────────────┬───────────────────┬──────────────────┬─────────────────┬───────────────╮
        &none      &none              &none  &uc UC_ES_E_ACUTE &none  &none                    &none              &uc UC_ES_U_ACUTE   &uc UC_ES_I_ACUTE   &uc UC_ES_O_ACUTE  &none             &none
//     ├──────────┼──────────────────┼──────┼─────────────────┼──────┼──────┤                 ├──────────────────┼───────────────────┼───────────────────┼──────────────────┼─────────────────┼───────────────┤
        &none      &uc UC_ES_A_ACUTE  &none  &none             &none  &none                    &none              &none               &none               &none              &none             &none
//     ├──────────┼──────────────────┼──────┼─────────────────┼──────┼──────┤                 ├──────────────────┼───────────────────┼───────────────────┼──────────────────┼─────────────────┼───────────────┤
        &kp LSHFT  &none              &none  &none             &none  &none                    &uc UC_ES_N_TILDE  &none               &none               &uc UC_INV_QMARK  &uc UC_INV_EXCL    &kp RSHFT
//     ╰──────────┴──────────────────┴──────┴─────────────────┼──────┼──────┼──────╮  ╭───────┼──────────────────┼───────────────────┼───────────────────┴──────────────────┴─────────────────┴───────────────╯
                                                               &none  &none  &none     &none   &none              &none
//                                                            ╰──────┴──────┴──────╯  ╰───────┴──────────────────┴───────────────────╯
                        >;
                        display-name = "ACUTE";
                };

                grave_layer {
// ╭───────┬─────┬─────┬─────┬─────┬─────╮              ╭─────┬─────┬─────┬─────┬─────┬───────╮
// │       │     │     │  è  │     │     │              │     │  ù  │  ì  │  ò  │     │       │
// ├───────┼─────┼─────┼─────┼─────┼─────┤              ├─────┼─────┼─────┼─────┼─────┼───────┤
// │       │  à  │     │     │     │     │              │     │     │     │     │     │       │
// ├───────┼─────┼─────┼─────┼─────┼─────┤              ├─────┼─────┼─────┼─────┼─────┼───────┤
// │LSHIFT │     │     │  ç  │     │     │              │     │     │  «  │  »  │     │ RSHIFT│
// ╰───────┴─────┴─────┴─────┼─────┼─────┼─────╮  ╭─────┼─────┼─────┼─────┴─────┴─────┴───────╯
//                           │     │     │     │  │     │     │     │
//                           ╰─────┴─────┴─────╯  ╰─────┴─────┴─────╯
                        bindings = <
//     ╭──────────┬──────────────────┬──────┬────────────────────┬──────┬──────╮                 ╭──────┬──────────────────┬───────────────────┬───────────────────┬──────┬──────╮
        &none      &none              &none  &uc UC_FR_E_GRAVE    &none  &none                    &none  &uc UC_FR_U_GRAVE  &uc UC_I_GRAVE      &uc UC_O_GRAVE      &none  &none
//     ├──────────┼──────────────────┼──────┼────────────────────┼──────┼──────┤                 ├──────┼──────────────────┼───────────────────┼───────────────────┼──────┼──────┤
        &none      &uc UC_FR_A_GRAVE  &none  &none                &none  &none                    &none  &none              &none               &none               &none  &none
//     ├──────────┼──────────────────┼──────┼────────────────────┼──────┼──────┤                 ├──────┼──────────────────┼───────────────────┼───────────────────┼──────┼──────┤
        &kp LSHFT  &none              &none  &uc UC_ES_C_CEDILLA  &none  &none                    &none  &none              &uc UC_L_GUILLEMET  &uc UC_R_GUILLEMET  &none  &kp RSHFT
//     ╰──────────┴──────────────────┴──────┴────────────────────┼──────┼──────┼──────╮  ╭───────┼──────┼──────────────────┼───────────────────┴───────────────────┴──────┴──────╯
                                                                  &none  &none  &none     &none   &none  &none
//                                                               ╰──────┴──────┴──────╯  ╰───────┴──────┴──────────────────╯
                        >;
                        display-name = "GRAVE";
                };

                // ─── Circumflex accent: â ê î ô û ────────────────────────────────────────
                circumflex_layer {
                        bindings = <
//     ╭──────────┬───────────────────────┬──────┬───────────────────────┬──────┬──────╮                 ╭──────┬───────────────────────┬───────────────────────┬───────────────────────┬──────┬──────╮
        &none      &none                   &none  &uc UC_FR_E_CIRCUMFLEX  &none  &none                    &none  &uc UC_FR_U_CIRCUMFLEX  &uc UC_FR_I_CIRCUMFLEX  &uc UC_FR_O_CIRCUMFLEX  &none  &none
//     ├──────────┼───────────────────────┼──────┼───────────────────────┼──────┼──────┤                 ├──────┼───────────────────────┼───────────────────────┼───────────────────────┼──────┼──────┤
        &none      &uc UC_FR_A_CIRCUMFLEX  &none  &none                   &none  &none                    &none  &none                   &none                   &none                   &none  &none
//     ├──────────┼───────────────────────┼──────┼───────────────────────┼──────┼──────┤                 ├──────┼───────────────────────┼───────────────────────┼───────────────────────┼──────┼──────┤
        &kp LSHFT  &none                   &none  &none                   &none  &none                    &none  &none                   &none                   &none                   &none  &kp RSHFT
//     ╰──────────┴───────────────────────┴──────┴───────────────────────┼──────┼──────┼──────╮  ╭───────┼──────┼───────────────────────┼───────────────────────┴───────────────────────┴──────┴──────╯
                                                                          &none  &none  &none     &none   &none  &none
//                                                                       ╰──────┴──────┴──────╯  ╰───────┴──────┴───────────────────────╯
                        >;
                        display-name = "CIRCUMFLEX";
                };

                // ─── Diaeresis / Umlaut: ä ë ï ö ü ÿ ────────────────────────────────────
                diaeresis_layer {
// ╭───────┬─────┬─────┬─────┬─────┬─────╮              ╭─────┬─────┬─────┬─────┬─────┬───────╮
// │       │     │     │  ë  │     │     │              │  ÿ  │  ü  │  ï  │  ö  │     │       │
// ├───────┼─────┼─────┼─────┼─────┼─────┤              ├─────┼─────┼─────┼─────┼─────┼───────┤
// │       │  ä  │     │     │     │     │              │     │     │     │     │     │       │
// ├───────┼─────┼─────┼─────┼─────┼─────┤              ├─────┼─────┼─────┼─────┼─────┼───────┤
// │LSHIFT │     │     │     │     │     │              │     │     │     │     │     │       │
// ╰───────┴─────┴─────┴─────┼─────┼─────┼─────╮  ╭─────┼─────┼─────┼─────┴─────┴─────┴───────╯
//                           │     │     │     │  │     │     │     │
//                           ╰─────┴─────┴─────╯  ╰─────┴─────┴─────╯
                        bindings = <
//     ╭──────────┬─────────────┬──────┬──────────────────────┬──────┬──────╮                 ╭─────────────────────┬─────────────┬───────────────────────┬──────────┬──────────────────────┬────────────────────╮
        &none      &none         &none  &uc UC_FR_E_DIAERESIS  &none  &none                    &uc UC_FR_Y_DIAERESIS &uc UC_DE_UE  &uc UC_FR_I_DIAERESIS   &uc UC_DE_OE &none                  &none
//     ├──────────┼─────────────┼──────┼──────────────────────┼──────┼──────┤                 ├─────────────────────┼─────────────┼───────────────────────┼──────────┼──────────────────────┼────────────────────┤
        &none      &uc UC_DE_AE  &none  &none                  &none  &none                    &none                 &none         &none                   &none       &uc UC_LOW_DBL_QUOTE   &uc UC_L_DBL_QUOTE
//     ├──────────┼─────────────┼──────┼──────────────────────┼──────┼──────┤                 ├─────────────────────┼─────────────┼───────────────────────┼──────────┼──────────────────────┼────────────────────┤
        &kp LSHFT  &none         &none  &none                  &none  &none                    &none                 &none         &uc UC_R_DBL_QUOTE      &none      &none                  &kp RSHFT
//     ╰──────────┴─────────────┴──────┴──────────────────────┼──────┼──────┼──────╮  ╭───────┼─────────────────────┼─────────────┼───────────────────────┴──────────┴──────────────────────┴────────────────────╯
                                                               &none  &none  &none     &none   &none                 &none
//                                                            ╰──────┴──────┴──────╯  ╰───────┴─────────────────────┴─────────────╯
                        >;
                        display-name = "DIAERESIS";
                };

                // ─── Special: æ œ ç ñ ß ─────────────────────────────────────────────────
                special_layer {
                        bindings = <
//     ╭─────────┬────────────┬────────────┬────────────────────┬──────┬──────╮                 ╭──────────────────┬────────────────┬────────────────┬─────────────┬──────┬─────────╮
        &none     &none        &none        &none                &none  &none                    &none              &none            &none            &uc UC_FR_OE  &none  &none
//     ├─────────┼────────────┼────────────┼────────────────────┼──────┼──────┤                 ├──────────────────┼────────────────┼────────────────┼─────────────┼──────┼─────────┤
        &none     &uc UC_FR_AE &uc UC_DE_SS &none                &none  &none                    &none              &none            &none            &none         &none  &none
//     ├─────────┼────────────┼────────────┼────────────────────┼──────┼──────┤                 ├──────────────────┼────────────────┼────────────────┼─────────────┼──────┼─────────┤
        &kp LSHFT &none        &none        &uc UC_ES_C_CEDILLA  &none  &none                    &uc UC_ES_N_TILDE  &none            &none            &none         &uc UC_DA_OE  &kp RSHFT
//     ╰─────────┴────────────┴────────────┴────────────────────┼──────┼──────┼──────╮  ╭───────┼──────────────────┼────────────────┼────────────────┴─────────────┴──────┴─────────╯
                                                                 &none  &none  &none     &none   &none             &none
//                                                              ╰──────┴──────┴──────╯  ╰───────┴──────────────────┴────────────────╯
                        >;
                        display-name = "SPECIAL";
                };

                // ─── Ogonek: ą ę į ų ─────────────────────────────────────────────────
                ogonek_layer {
                        bindings = <
//     ╭──────┬──────┬──────┬─────────────────┬──────┬──────╮                 ╭──────┬─────────────────┬────────────────┬──────┬──────┬──────╮
        &none  &none  &none  &uc UC_PL_E_OGONEK &none  &none                   &none  &uc UC_U_OGONEK    &uc UC_I_OGONEK  &none  &none  &none
//     ├──────┼──────┼──────┼─────────────────┼──────┼──────┤                 ├──────┼─────────────────┼────────────────┼──────┼──────┼──────┤
        &none  &uc UC_PL_A_OGONEK &none &none   &none  &none                   &none  &none              &none            &none  &none  &none
//     ├──────┼──────┼──────┼─────────────────┼──────┼──────┤                 ├──────┼─────────────────┼────────────────┼──────┼──────┼──────┤
        &kp LSHFT  &none  &none  &none             &none  &none                   &none  &none              &none            &none  &none  &kp RSHFT
//     ╰──────┴──────┴──────┴─────────────────┼──────┼──────┼──────╮  ╭───────┼──────┼─────────────────┼────────────────┴──────┴──────┴──────╯
                                               &none  &none  &none     &none   &none  &none
//                                            ╰──────┴──────┴──────╯  ╰───────┴──────┴─────────────────╯
                        >;
                        display-name = "OGONEK";
                };

                // ─── Dot marks: below (a,e,i,o,u) and above (z,c,s) ───────────────────
                dot_marks_layer {
                        bindings = <
//     ╭──────┬──────┬──────┬─────────────────┬──────┬──────╮                 ╭──────┬─────────────────┬─────────────────┬─────────────────┬──────┬──────╮
        &none  &none  &none  &uc UC_E_DOT_BELOW &none  &none                   &none  &uc UC_U_DOT_BELOW &uc UC_I_DOT_BELOW &uc UC_O_DOT_BELOW &none  &none
//     ├──────┼──────┼──────┼─────────────────┼──────┼──────┤                 ├──────┼─────────────────┼─────────────────┼─────────────────┼──────┼──────┤
        &none  &uc UC_A_DOT_BELOW &uc UC_S_DOT_ABOVE &none &none &none          &none  &none             &none             &none             &none  &none
//     ├──────┼──────┼──────┼─────────────────┼──────┼──────┤                 ├──────┼─────────────────┼─────────────────┼─────────────────┼──────┼──────┤
        &kp LSHFT  &uc UC_PL_Z_DOT &none &uc UC_C_DOT_ABOVE &none &none             &none  &none             &none             &none             &none  &kp RSHFT
//     ╰──────┴──────┴──────┴─────────────────┼──────┼──────┼──────╮  ╭───────┼──────┼─────────────────┼─────────────────┴─────────────────┴──────┴──────╯
                                               &none  &none  &none     &none   &none  &none
//                                            ╰──────┴──────┴──────╯  ╰───────┴──────┴─────────────────╯
                        >;
                        display-name = "DOT";
                };

                // ─── Comma-below: ș ț ─────────────────────────────────────────────────
                comma_below_layer {
                    bindings = <
                    //     ╭──────────┬──────┬──────┬──────┬──────┬──────╮                 ╭──────┬──────┬──────┬──────┬──────┬──────╮
                            &none      &none  &none  &none  &none  &none                    &none  &none  &none  &none  &none  &none
                    //     ├──────────┼──────┼──────┼──────┼──────┼──────┤                 ├──────┼──────┼──────┼──────┼──────┼──────┤
                            &none      &none  &uc UC_RO_S &none &none &none                  &none  &none  &none  &none  &none  &none
                    //     ├──────────┼──────┼──────┼──────┼──────┼──────┤                 ├──────┼──────┼──────┼──────┼──────┼──────┤
                            &kp LSHFT  &none  &none  &none  &none  &none                    &uc UC_RO_T &none &none &none &none &kp RSHFT
                    //     ╰──────────┴──────┴──────┴──────┼──────┼──────┼──────╮  ╭───────┼──────┼──────┼──────┴──────┴──────┴──────╯
                                                            &none  &none  &none     &none   &none  &none
                    //                                     ╰──────┴──────┴──────╯  ╰───────┴──────┴──────╯
                    >;
                        display-name = "COMMA";
                };

                // ─── Double acute: ő ű ────────────────────────────────────────────────
                dbl_acute_layer {
                        bindings = <
//     ╭──────┬──────┬──────┬──────┬──────┬──────╮                 ╭──────┬──────────────────┬──────┬──────────────────┬──────┬──────╮
        &none  &none  &none  &none  &none  &none                    &none  &uc UC_U_DOUBLE_ACUTE &none &uc UC_O_DOUBLE_ACUTE &none &none
//     ├──────┼──────┼──────┼──────┼──────┼──────┤                 ├──────┼──────────────────┼──────┼──────────────────┼──────┼──────┤
        &none  &none  &none  &none  &none  &none                    &none  &none               &none  &none               &none  &none
//     ├──────┼──────┼──────┼──────┼──────┼──────┤                 ├──────┼──────────────────┼──────┼──────────────────┼──────┼──────┤
        &kp LSHFT  &none  &none  &none  &none  &none                    &none  &none               &none  &none               &none  &kp RSHFT
//     ╰──────┴──────┴──────┴──────┼──────┼──────┼──────╮  ╭───────┼──────┼──────────────────┼──────┴──────────────────┴──────┴──────╯
                                   &none  &none  &none     &none   &none  &none
//                                ╰──────┴──────┴──────╯  ╰───────┴──────┴──────────────────╯
                        >;
                        display-name = "DBL-AC";
                };

                // ─── Caron/Breve: č š ž ř ě ň ď ť ľ + ă ĕ ğ ──────────────────────────────
                caron_breve_layer {
                        bindings = <
//     ╭──────┬──────┬──────────────┬────────────────┬────────────────┬────────────────╮                 ╭──────┬──────┬──────┬────────────────┬──────┬──────╮
        &none  &none  &uc UC_E_BREVE &uc UC_E_CARON   &uc UC_CS_RC     &uc UC_CS_TC              &none  &none  &none  &none            &none  &none
//     ├──────┼──────┼──────────────┼────────────────┼────────────────┼────────────────┤                 ├──────┼──────┼──────┼────────────────┼──────┼──────┤
        &none  &uc UC_RO_A &uc UC_CS_SC &uc UC_CS_DC &none &uc UC_G_BREVE                        &none  &none  &none  &uc UC_L_CARON   &none  &none
//     ├──────┼──────┼──────────────┼────────────────┼────────────────┼────────────────┤                 ├──────┼──────┼──────┼────────────────┼──────┼──────┤
        &kp LSHFT  &uc UC_CS_ZC &none &uc UC_CS_CC &none &none                                   &uc UC_CS_NC &none &none &none &none &kp RSHFT
//     ╰──────┴──────┴────────────────┴────────────────┼────────────────┼──────┼──────╮  ╭───────┼──────┼────────────────┼──────┴────────────────┴──────┴──────╯
                                                       &none            &none  &none     &none   &none  &none
//                                                    ╰────────────────┴──────┴──────╯  ╰───────┴──────┴────────────────╯
                        >;
                        display-name = "CARON";
                };

                // ─── Ring: å ů + ℃ ℉ ────────────────────────────────────────────────────
                ring_layer {
                        bindings = <
//     ╭──────┬──────┬──────┬──────┬──────┬──────╮                 ╭──────┬────────────┬──────┬──────┬──────┬──────╮
        &none  &none  &none  &none  &none  &none                    &none  &uc UC_CS_UR  &none  &none  &none  &none
//     ├──────┼──────┼──────┼──────┼──────┼──────┤                 ├──────┼────────────┼──────┼──────┼──────┼──────┤
        &none  &uc UC_A_RING &none &none &none &none                &none  &none         &none  &none  &none  &none
//     ├──────┼──────┼──────┼──────┼──────┼──────┤                 ├──────┼────────────┼──────┼──────┼──────┼──────┤
        &kp LSHFT  &none  &none  &uc UC_DEGREE_CELSIUS  &uc UC_DEGREE_FAHRENHEIT  &none     &none  &none         &none  &none  &none  &kp RSHFT
//     ╰──────┴──────┴──────┴──────┼──────┼──────┼──────╮  ╭───────┼──────┼────────────┼──────┴──────┴──────┴──────╯
                                   &none  &none  &none     &none   &none  &none
//                                ╰──────┴──────┴──────╯  ╰───────┴──────┴────────────╯
                        >;
                        display-name = "RING";
                };

                // ─── Macron: ā ē ī ō ū ────────────────────────────────────────────────
                macron_layer {
                        bindings = <
//     ╭──────┬──────┬──────┬────────────────┬──────┬──────╮                 ╭──────┬────────────────┬────────────────┬────────────────┬──────┬──────╮
        &none  &none  &none  &uc UC_E_MACRON  &none  &none                    &none  &uc UC_U_MACRON   &uc UC_I_MACRON   &uc UC_O_MACRON   &none  &none
//     ├──────┼──────┼──────┼────────────────┼──────┼──────┤                 ├──────┼────────────────┼────────────────┼────────────────┼──────┼──────┤
        &none  &uc UC_A_MACRON &none &none    &none  &none                    &none  &none             &none             &none             &none  &none
//     ├──────┼──────┼──────┼────────────────┼──────┼──────┤                 ├──────┼────────────────┼────────────────┼────────────────┼──────┼──────┤
        &kp LSHFT  &none  &none  &none            &none  &none                    &none  &none             &none             &none             &none  &kp RSHFT
//     ╰──────┴──────┴──────┴────────────────┼──────┼──────┼──────╮  ╭───────┼──────┼────────────────┼────────────────┴────────────────┴──────┴──────╯
                                              &none  &none  &none     &none   &none  &none
//                                           ╰──────┴──────┴──────╯  ╰───────┴──────┴────────────────╯
                        >;
                        display-name = "MACRON";
                };
        };
};
