## config/west.yml
```yaml
manifest:
  remotes:
    - name: zmkfirmware
      url-base: https://github.com/zmkfirmware
    - name: penguinchat
      url-base: https://github.com/penguinchat
    - name: carrefinho
      url-base: https://github.com/carrefinho
    - name: carrefinho
      url-base: https://github.com/carrefinho
    # Leader, Unicode, Helpers & Antecedent Morph Key Support
    - name: urob
      url-base: https://github.com/urob
    # nice!view drivers
    - name: mctechnology17
      url-base: https://github.com/mctechnology17
  projects:
    - name: zmk
      remote: zmkfirmware
      revision: main
      import: app/west.yml
    - name: zmk-for-PandaKB.com-
      remote: penguinchat
      revision: PandaKB_Lily58
    - name: prospector-zmk-module
      remote: carrefinho
      revision: feat/new-status-screens
    # Unicode Key Support
    - name: zmk-unicode
      remote: urob
      revision: main
    # Leader Key Support
    - name: zmk-leader-key
      remote: urob
      revision: main
    # Antecedent Morph Key Support
    - name: zmk-adaptive-key
      remote: urob
      revision: main
    # Helper Macros
    - name: zmk-helpers
      remote: urob
      revision: main
    # support nice_oled and nice_epaper
    - name: zmk-nice-oled
      remote: mctechnology17
      revision: main
  self:
    path: config
```
